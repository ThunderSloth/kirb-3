/**
 * @cliArgs --board "/ti/boards/LP_MSPM0G3507" --product "mspm0_sdk@2.06.00.06"
 * @versions {"tool":"1.25.0+4268"}
 */

/**
 * Import the modules used in this configuration.
 */
const ADC12    = scripting.addModule("/ti/driverlib/ADC12", {}, false);
const ADC121   = ADC12.addInstance();
const CAPTURE  = scripting.addModule("/ti/driverlib/CAPTURE", {}, false);
const CAPTURE1 = CAPTURE.addInstance();
const CAPTURE2 = CAPTURE.addInstance();
const CAPTURE3 = CAPTURE.addInstance();
const DMA      = scripting.addModule("/ti/driverlib/DMA");
const GPIO     = scripting.addModule("/ti/driverlib/GPIO", {}, false);
const GPIO1    = GPIO.addInstance();
const GPIO2    = GPIO.addInstance();
const GPIO3    = GPIO.addInstance();
const GPIO4    = GPIO.addInstance();
const I2C      = scripting.addModule("/ti/driverlib/I2C", {}, false);
const I2C1     = I2C.addInstance();
const PWM      = scripting.addModule("/ti/driverlib/PWM", {}, false);
const PWM1     = PWM.addInstance();
const SPI      = scripting.addModule("/ti/driverlib/SPI", {}, false);
const SPI1     = SPI.addInstance();
const SYSCTL   = scripting.addModule("/ti/driverlib/SYSCTL");
const TIMER    = scripting.addModule("/ti/driverlib/TIMER", {}, false);
const TIMER1   = TIMER.addInstance();
const UART     = scripting.addModule("/ti/driverlib/UART", {}, false);
const UART1    = UART.addInstance();
const UART2    = UART.addInstance();
const UART3    = UART.addInstance();
const VREF     = scripting.addModule("/ti/driverlib/VREF");

/**
 * Write custom configuration values to the imported modules.
 */
const divider9       = system.clockTree["UDIV"];
divider9.divideValue = 2;

const mux4       = system.clockTree["EXHFMUX"];
mux4.inputSelect = "EXHFMUX_XTAL";

const mux8       = system.clockTree["HSCLKMUX"];
mux8.inputSelect = "HSCLKMUX_HFCLK";

const mux10       = system.clockTree["MFPCLKMUX"];
mux10.inputSelect = "MFPCLKMUX_HFCLK";

const pinFunction4        = system.clockTree["HFXT"];
pinFunction4.inputFreq    = 40;
pinFunction4.HFXTStartup  = 10;
pinFunction4.HFCLKMonitor = true;
pinFunction4.enable       = true;

ADC121.$name                             = "V_MEAS";
ADC121.adcMem0vref                       = "VREF";
ADC121.peripheral.adcPin0.$assign        = "boosterpack.8";
ADC121.adcPin0Config.hideOutputInversion = scripting.forceWrite(false);
ADC121.adcPin0Config.$name               = "ti_driverlib_gpio_GPIOPinGeneric16";

const Board = scripting.addModule("/ti/driverlib/Board", {}, false);

CAPTURE1.captureInputMode                   = "multi";
CAPTURE1.ccIndexMulti                       = [0,1,2,3];
CAPTURE1.multi_countMode                    = "DL_TIMER_COUNT_MODE_UP";
CAPTURE1.multi_countRep                     = "DL_TIMER_REPEAT_MODE_ENABLED";
CAPTURE1.multi_cvae                         = "DL_TIMER_COUNT_AFTER_EN_ZERO";
CAPTURE1.timerPeriod                        = "65ms";
CAPTURE1.multi_ch1_captEdgeDetection        = "DL_TIMER_CC_CCOND_TRIG_FALL";
CAPTURE1.multi_ch3_captEdgeDetection        = "DL_TIMER_CC_CCOND_TRIG_FALL";
CAPTURE1.$name                              = "RC_TIM0";
CAPTURE1.mainCrossTriggerSource             = "ZERO";
CAPTURE1.multi_ch_zero                      = 0;
CAPTURE1.multi_ch2_captEdgeDetection        = "DL_TIMER_CC_CCOND_TRIG_FALL";
CAPTURE1.multi_ch1_input_mode               = "DL_TIMER_CC_IN_SEL_CCPX_PAIR";
CAPTURE1.interrupts                         = ["CC1_UP","CC2_UP","CC3_UP"];
CAPTURE1.timerClkPrescale                   = 40;
CAPTURE1.ccp0PinConfig.$name                = "ti_driverlib_gpio_GPIOPinGeneric0";
CAPTURE1.ccp0PinConfig.hideOutputInversion  = scripting.forceWrite(false);
CAPTURE1.ccp0PinConfig.onlyInternalResistor = scripting.forceWrite(false);
CAPTURE1.ccp0PinConfig.passedPeripheralType = scripting.forceWrite("Digital");
CAPTURE1.ccp2PinConfig.hideOutputInversion  = scripting.forceWrite(false);
CAPTURE1.ccp2PinConfig.onlyInternalResistor = scripting.forceWrite(false);
CAPTURE1.ccp2PinConfig.passedPeripheralType = scripting.forceWrite("Digital");
CAPTURE1.ccp2PinConfig.$name                = "ti_driverlib_gpio_GPIOPinGeneric1";
CAPTURE1.ccp3PinConfig.hideOutputInversion  = scripting.forceWrite(false);
CAPTURE1.ccp3PinConfig.onlyInternalResistor = scripting.forceWrite(false);
CAPTURE1.ccp3PinConfig.passedPeripheralType = scripting.forceWrite("Digital");
CAPTURE1.ccp3PinConfig.$name                = "ti_driverlib_gpio_GPIOPinGeneric3";
CAPTURE1.peripheral.$assign                 = "TIMA0";
CAPTURE1.peripheral.ccp0Pin.$assign         = "boosterpack.15";
CAPTURE1.peripheral.ccp2Pin.$assign         = "boosterpack.30";

CAPTURE2.captureInputMode                   = "multi";
CAPTURE2.multi_countMode                    = "DL_TIMER_COUNT_MODE_UP";
CAPTURE2.ccIndexMulti                       = [0,1];
CAPTURE2.multi_cvae                         = "DL_TIMER_COUNT_AFTER_EN_ZERO";
CAPTURE2.$name                              = "RC_TIM1";
CAPTURE2.timerPeriod                        = "65ms";
CAPTURE2.multi_ch1_captEdgeDetection        = "DL_TIMER_CC_CCOND_TRIG_FALL";
CAPTURE2.interrupts                         = ["CC0_UP","CC1_UP"];
CAPTURE2.crossTriggerAuthority              = "Secondary";
CAPTURE2.multi_countRep                     = "DL_TIMER_REPEAT_MODE_ENABLED";
CAPTURE2.multi_ch1_input_mode               = "DL_TIMER_CC_IN_SEL_CCPX_PAIR";
CAPTURE2.multi_ch_zero                      = 0;
CAPTURE2.timerStartTimer                    = true;
CAPTURE2.timerClkPrescale                   = 40;
CAPTURE2.ccp0PinConfig.$name                = "ti_driverlib_gpio_GPIOPinGeneric2";
CAPTURE2.ccp0PinConfig.hideOutputInversion  = scripting.forceWrite(false);
CAPTURE2.ccp0PinConfig.onlyInternalResistor = scripting.forceWrite(false);
CAPTURE2.ccp0PinConfig.passedPeripheralType = scripting.forceWrite("Digital");
CAPTURE2.peripheral.$assign                 = "TIMG7";
CAPTURE2.peripheral.ccp0Pin.$assign         = "boosterpack.38";

CAPTURE3.$name                                    = "ULT_ECHO_TIM";
CAPTURE3.timerPeriod                              = "65 ms";
CAPTURE3.captureInputMode                         = "multi";
CAPTURE3.multi_countMode                          = "DL_TIMER_COUNT_MODE_UP";
CAPTURE3.multi_countRep                           = "DL_TIMER_REPEAT_MODE_ENABLED";
CAPTURE3.multi_ch_zero                            = 0;
CAPTURE3.ccIndexMulti                             = [0,1];
CAPTURE3.multi_ch1_input_mode                     = "DL_TIMER_CC_IN_SEL_CCPX_PAIR";
CAPTURE3.interrupts                               = ["CC1_UP"];
CAPTURE3.timerClkPrescale                         = 20;
CAPTURE3.multi_ch1_captEdgeDetection              = "DL_TIMER_CC_CCOND_TRIG_FALL";
CAPTURE3.multi_cvae                               = "DL_TIMER_COUNT_AFTER_EN_ZERO";
CAPTURE3.ccp0PinConfig.$name                      = "ti_driverlib_gpio_GPIOPinGeneric18";
CAPTURE3.peripheral.$assign                       = "TIMG0";
CAPTURE3.peripheral.ccp0Pin.$assignAllowConflicts = "boosterpack.32";

GPIO1.$name                         = "RC_IN";
GPIO1.port                          = "PORTB";
GPIO1.associatedPins.create(2);
GPIO1.associatedPins[0].direction   = "INPUT";
GPIO1.associatedPins[0].polarity    = "FALL";
GPIO1.associatedPins[0].interruptEn = true;
GPIO1.associatedPins[0].$name       = "CH5";
GPIO1.associatedPins[0].pin.$assign = "boosterpack.18";
GPIO1.associatedPins[1].$name       = "CH6";
GPIO1.associatedPins[1].direction   = "INPUT";
GPIO1.associatedPins[1].polarity    = "FALL";
GPIO1.associatedPins[1].interruptEn = true;
GPIO1.associatedPins[1].pin.$assign = "boosterpack.19";

GPIO2.$name                          = "MUX";
GPIO2.associatedPins.create(5);
GPIO2.associatedPins[0].$name        = "EN0";
GPIO2.associatedPins[0].initialValue = "SET";
GPIO2.associatedPins[0].pin.$assign  = "boosterpack.23";
GPIO2.associatedPins[1].$name        = "EN1";
GPIO2.associatedPins[1].initialValue = "SET";
GPIO2.associatedPins[1].pin.$assign  = "boosterpack.24";
GPIO2.associatedPins[2].$name        = "SEL0";
GPIO2.associatedPins[2].pin.$assign  = "boosterpack.25";
GPIO2.associatedPins[3].$name        = "SEL1";
GPIO2.associatedPins[3].pin.$assign  = "boosterpack.26";
GPIO2.associatedPins[4].$name        = "SEL2";
GPIO2.associatedPins[4].pin.$assign  = "boosterpack.27";

GPIO3.$name                          = "BUF";
GPIO3.associatedPins.create(2);
GPIO3.associatedPins[0].$name        = "EN";
GPIO3.associatedPins[0].initialValue = "SET";
GPIO3.associatedPins[0].pin.$assign  = "boosterpack.37";
GPIO3.associatedPins[1].$name        = "DIR";
GPIO3.associatedPins[1].initialValue = "SET";
GPIO3.associatedPins[1].pin.$assign  = "boosterpack.31";

GPIO4.$name                       = "PING";
GPIO4.associatedPins[0].$name     = "TRIG";
GPIO4.associatedPins[0].direction = "INPUT";

I2C1.$name                             = "I2C_IMU";
I2C1.peripheral.sdaPin.$assign         = "boosterpack.10";
I2C1.peripheral.sclPin.$assign         = "boosterpack.9";
I2C1.sdaPinConfig.hideOutputInversion  = scripting.forceWrite(false);
I2C1.sdaPinConfig.onlyInternalResistor = scripting.forceWrite(false);
I2C1.sdaPinConfig.passedPeripheralType = scripting.forceWrite("Digital");
I2C1.sdaPinConfig.$name                = "ti_driverlib_gpio_GPIOPinGeneric8";
I2C1.sclPinConfig.hideOutputInversion  = scripting.forceWrite(false);
I2C1.sclPinConfig.onlyInternalResistor = scripting.forceWrite(false);
I2C1.sclPinConfig.passedPeripheralType = scripting.forceWrite("Digital");
I2C1.sclPinConfig.$name                = "ti_driverlib_gpio_GPIOPinGeneric9";

PWM1.timerCount                         = 20000;
PWM1.timerStartTimer                    = true;
PWM1.pwmMode                            = "EDGE_ALIGN_UP";
PWM1.enableShadowLoad                   = true;
PWM1.$name                              = "MOTOR_PWM";
PWM1.clockPrescale                      = 40;
PWM1.peripheral.$assign                 = "TIMA1";
PWM1.peripheral.ccp0Pin.$assign         = "boosterpack.40";
PWM1.peripheral.ccp1Pin.$assign         = "boosterpack.39";
PWM1.PWM_CHANNEL_0.$name                = "ti_driverlib_pwm_PWMTimerCC0";
PWM1.PWM_CHANNEL_0.initVal              = "HIGH";
PWM1.PWM_CHANNEL_0.dutyCycle            = 50;
PWM1.PWM_CHANNEL_0.shadowUpdateMode     = "ZERO_EVT";
PWM1.PWM_CHANNEL_0.ccValue              = 1500;
PWM1.PWM_CHANNEL_1.$name                = "ti_driverlib_pwm_PWMTimerCC1";
PWM1.PWM_CHANNEL_1.initVal              = "HIGH";
PWM1.PWM_CHANNEL_1.dutyCycle            = 50;
PWM1.PWM_CHANNEL_1.shadowUpdateMode     = "ZERO_EVT";
PWM1.PWM_CHANNEL_1.ccValue              = 1500;
PWM1.ccp0PinConfig.direction            = scripting.forceWrite("OUTPUT");
PWM1.ccp0PinConfig.hideOutputInversion  = scripting.forceWrite(false);
PWM1.ccp0PinConfig.onlyInternalResistor = scripting.forceWrite(false);
PWM1.ccp0PinConfig.passedPeripheralType = scripting.forceWrite("Digital");
PWM1.ccp0PinConfig.$name                = "ti_driverlib_gpio_GPIOPinGeneric4";
PWM1.ccp1PinConfig.direction            = scripting.forceWrite("OUTPUT");
PWM1.ccp1PinConfig.hideOutputInversion  = scripting.forceWrite(false);
PWM1.ccp1PinConfig.onlyInternalResistor = scripting.forceWrite(false);
PWM1.ccp1PinConfig.passedPeripheralType = scripting.forceWrite("Digital");
PWM1.ccp1PinConfig.$name                = "ti_driverlib_gpio_GPIOPinGeneric5";

SPI1.$name                              = "SPI_FRAM";
SPI1.peripheral.sclkPin.$assign         = "boosterpack.28";
SPI1.peripheral.misoPin.$assign         = "boosterpack.29";
SPI1.peripheral.cs0Pin.$assign          = "boosterpack.5";
SPI1.sclkPinConfig.direction            = scripting.forceWrite("OUTPUT");
SPI1.sclkPinConfig.onlyInternalResistor = scripting.forceWrite(false);
SPI1.sclkPinConfig.passedPeripheralType = scripting.forceWrite("Digital");
SPI1.sclkPinConfig.$name                = "ti_driverlib_gpio_GPIOPinGeneric12";
SPI1.mosiPinConfig.direction            = scripting.forceWrite("OUTPUT");
SPI1.mosiPinConfig.hideOutputInversion  = scripting.forceWrite(false);
SPI1.mosiPinConfig.onlyInternalResistor = scripting.forceWrite(false);
SPI1.mosiPinConfig.passedPeripheralType = scripting.forceWrite("Digital");
SPI1.mosiPinConfig.$name                = "ti_driverlib_gpio_GPIOPinGeneric13";
SPI1.misoPinConfig.onlyInternalResistor = scripting.forceWrite(false);
SPI1.misoPinConfig.passedPeripheralType = scripting.forceWrite("Digital");
SPI1.misoPinConfig.$name                = "ti_driverlib_gpio_GPIOPinGeneric14";
SPI1.cs0PinConfig.direction             = scripting.forceWrite("OUTPUT");
SPI1.cs0PinConfig.hideOutputInversion   = scripting.forceWrite(false);
SPI1.cs0PinConfig.onlyInternalResistor  = scripting.forceWrite(false);
SPI1.cs0PinConfig.passedPeripheralType  = scripting.forceWrite("Digital");
SPI1.cs0PinConfig.$name                 = "ti_driverlib_gpio_GPIOPinGeneric15";

SYSCTL.MCLKSource      = "HSCLK";
SYSCTL.HSCLKSource     = "HFCLK";
SYSCTL.HFCLKMonitor    = true;
SYSCTL.HFCLKSource     = "HFXT";
SYSCTL.useHFCLK_Manual = true;
SYSCTL.HFCLK_Freq      = 40000000;
SYSCTL.clockTreeEn     = true;

TIMER1.timerMode        = "PERIODIC_UP";
TIMER1.interrupts       = ["CC0_UP","LOAD","ZERO"];
TIMER1.$name            = "ULT_SCHED_TIM";
TIMER1.timerClkPrescale = 40;
TIMER1.timerPeriod      = "60 ms";

UART1.$name                            = "UART_ESP32";
UART1.targetBaudRate                   = 115200;
UART1.peripheral.rxPin.$assign         = "boosterpack.3";
UART1.peripheral.txPin.$assign         = "boosterpack.4";
UART1.txPinConfig.direction            = scripting.forceWrite("OUTPUT");
UART1.txPinConfig.hideOutputInversion  = scripting.forceWrite(false);
UART1.txPinConfig.onlyInternalResistor = scripting.forceWrite(false);
UART1.txPinConfig.passedPeripheralType = scripting.forceWrite("Digital");
UART1.txPinConfig.$name                = "ti_driverlib_gpio_GPIOPinGeneric10";
UART1.rxPinConfig.hideOutputInversion  = scripting.forceWrite(false);
UART1.rxPinConfig.onlyInternalResistor = scripting.forceWrite(false);
UART1.rxPinConfig.passedPeripheralType = scripting.forceWrite("Digital");
UART1.rxPinConfig.$name                = "ti_driverlib_gpio_GPIOPinGeneric11";

UART2.$name                            = "UART_DEBUG";
UART2.targetBaudRate                   = 115200;
UART2.peripheral.rxPin.$assign         = "boosterpack.33";
UART2.peripheral.txPin.$assign         = "boosterpack.34";
UART2.txPinConfig.direction            = scripting.forceWrite("OUTPUT");
UART2.txPinConfig.hideOutputInversion  = scripting.forceWrite(false);
UART2.txPinConfig.onlyInternalResistor = scripting.forceWrite(false);
UART2.txPinConfig.passedPeripheralType = scripting.forceWrite("Digital");
UART2.txPinConfig.$name                = "ti_driverlib_gpio_GPIOPinGeneric19";
UART2.rxPinConfig.hideOutputInversion  = scripting.forceWrite(false);
UART2.rxPinConfig.onlyInternalResistor = scripting.forceWrite(false);
UART2.rxPinConfig.passedPeripheralType = scripting.forceWrite("Digital");
UART2.rxPinConfig.$name                = "ti_driverlib_gpio_GPIOPinGeneric20";

UART3.targetBaudRate                       = 19200;
UART3.$name                                = "UART_ENCODER";
UART3.enabledDMARXTriggers                 = "DL_UART_DMA_INTERRUPT_RX";
UART3.enabledInterrupts                    = ["DMA_DONE_RX"];
UART3.rxTimeoutValue                       = 15;
UART3.peripheral.rxPin.$assign             = "boosterpack.11";
UART3.peripheral.txPin.$assign             = "boosterpack.17";
UART3.txPinConfig.direction                = scripting.forceWrite("OUTPUT");
UART3.txPinConfig.hideOutputInversion      = scripting.forceWrite(false);
UART3.txPinConfig.onlyInternalResistor     = scripting.forceWrite(false);
UART3.txPinConfig.passedPeripheralType     = scripting.forceWrite("Digital");
UART3.txPinConfig.$name                    = "ti_driverlib_gpio_GPIOPinGeneric6";
UART3.rxPinConfig.hideOutputInversion      = scripting.forceWrite(false);
UART3.rxPinConfig.onlyInternalResistor     = scripting.forceWrite(false);
UART3.rxPinConfig.passedPeripheralType     = scripting.forceWrite("Digital");
UART3.rxPinConfig.$name                    = "ti_driverlib_gpio_GPIOPinGeneric7";
UART3.DMA_CHANNEL_RX.addressMode           = "f2b";
UART3.DMA_CHANNEL_RX.configureTransferSize = true;
UART3.DMA_CHANNEL_RX.srcLength             = "BYTE";
UART3.DMA_CHANNEL_RX.dstLength             = "BYTE";
UART3.DMA_CHANNEL_RX.$name                 = "ENCODER_RX";
UART3.DMA_CHANNEL_RX.transferSize          = 2;
UART3.DMA_CHANNEL_RX.enableInterrupt       = true;

VREF.basicExtVolt           = 3.3;
VREF.basicIntVolt           = "DL_VREF_BUFCONFIG_OUTPUT_2_5V";
VREF.peripheral.$assign     = "VREF";
VREF.vrefPosPinConfig.$name = "ti_driverlib_gpio_GPIOPinGeneric17";

/**
 * Pinmux solution for unlocked pins/peripherals. This ensures that minor changes to the automatic solver in a future
 * version of the tool will not impact the pinmux you originally saw.  These lines can be completely deleted in order to
 * re-solve from scratch.
 */
pinFunction4.peripheral.$suggestSolution           = "SYSCTL";
pinFunction4.peripheral.hfxInPin.$suggestSolution  = "j17_expansion.4";
pinFunction4.peripheral.hfxOutPin.$suggestSolution = "j17_expansion.5";
ADC121.peripheral.$suggestSolution                 = "ADC0";
Board.peripheral.$suggestSolution                  = "DEBUGSS";
Board.peripheral.swclkPin.$suggestSolution         = "j25_expansion.16";
Board.peripheral.swdioPin.$suggestSolution         = "j25_expansion.14";
CAPTURE1.peripheral.ccp3Pin.$suggestSolution       = "boosterpack.2";
GPIO4.associatedPins[0].pin.$suggestSolution       = "boosterpack.35";
I2C1.peripheral.$suggestSolution                   = "I2C1";
SPI1.peripheral.$suggestSolution                   = "SPI1";
SPI1.peripheral.mosiPin.$suggestSolution           = "j19_expansion.5";
TIMER1.peripheral.$suggestSolution                 = "TIMG6";
UART1.peripheral.$suggestSolution                  = "UART1";
UART2.peripheral.$suggestSolution                  = "UART0";
UART3.peripheral.$suggestSolution                  = "UART2";
UART3.DMA_CHANNEL_RX.peripheral.$suggestSolution   = "DMA_CH0";
VREF.peripheral.vrefPosPin.$suggestSolution        = "j17_expansion.10";
