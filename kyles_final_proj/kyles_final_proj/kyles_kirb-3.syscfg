/**
 * @cliArgs --board "/ti/boards/LP_MSPM0G3507" --product "mspm0_sdk@2.06.00.06"
 * @versions {"tool":"1.25.0+4268"}
 */

/**
 * Import the modules used in this configuration.
 */
const CAPTURE  = scripting.addModule("/ti/driverlib/CAPTURE", {}, false);
const CAPTURE1 = CAPTURE.addInstance();
const CAPTURE2 = CAPTURE.addInstance();
const GPIO     = scripting.addModule("/ti/driverlib/GPIO", {}, false);
const GPIO1    = GPIO.addInstance();
const PWM      = scripting.addModule("/ti/driverlib/PWM", {}, false);
const PWM1     = PWM.addInstance();
const SYSCTL   = scripting.addModule("/ti/driverlib/SYSCTL");

/**
 * Write custom configuration values to the imported modules.
 */
CAPTURE1.captureInputMode                   = "multi";
CAPTURE1.timerClkPrescale                   = 32;
CAPTURE1.timerStartTimer                    = true;
CAPTURE1.ccIndexMulti                       = [0,1,2,3];
CAPTURE1.multi_countMode                    = "DL_TIMER_COUNT_MODE_UP";
CAPTURE1.multi_countRep                     = "DL_TIMER_REPEAT_MODE_ENABLED";
CAPTURE1.multi_cvae                         = "DL_TIMER_COUNT_AFTER_EN_ZERO";
CAPTURE1.timerPeriod                        = "65ms";
CAPTURE1.multi_ch1_captEdgeDetection        = "DL_TIMER_CC_CCOND_TRIG_FALL";
CAPTURE1.multi_ch3_captEdgeDetection        = "DL_TIMER_CC_CCOND_TRIG_FALL";
CAPTURE1.$name                              = "RC_TIM0";
CAPTURE1.mainCrossTriggerSource             = "ZERO";
CAPTURE1.multi_ch_zero                      = 0;
CAPTURE1.multi_ch2_captEdgeDetection        = "DL_TIMER_CC_CCOND_TRIG_FALL";
CAPTURE1.multi_ch1_input_mode               = "DL_TIMER_CC_IN_SEL_CCPX_PAIR";
CAPTURE1.interrupts                         = ["CC1_UP","CC2_UP","CC3_UP"];
CAPTURE1.ccp0PinConfig.$name                = "ti_driverlib_gpio_GPIOPinGeneric0";
CAPTURE1.ccp0PinConfig.hideOutputInversion  = scripting.forceWrite(false);
CAPTURE1.ccp0PinConfig.onlyInternalResistor = scripting.forceWrite(false);
CAPTURE1.ccp0PinConfig.passedPeripheralType = scripting.forceWrite("Digital");
CAPTURE1.ccp2PinConfig.hideOutputInversion  = scripting.forceWrite(false);
CAPTURE1.ccp2PinConfig.onlyInternalResistor = scripting.forceWrite(false);
CAPTURE1.ccp2PinConfig.passedPeripheralType = scripting.forceWrite("Digital");
CAPTURE1.ccp2PinConfig.$name                = "ti_driverlib_gpio_GPIOPinGeneric1";
CAPTURE1.ccp3PinConfig.hideOutputInversion  = scripting.forceWrite(false);
CAPTURE1.ccp3PinConfig.onlyInternalResistor = scripting.forceWrite(false);
CAPTURE1.ccp3PinConfig.passedPeripheralType = scripting.forceWrite("Digital");
CAPTURE1.ccp3PinConfig.$name                = "ti_driverlib_gpio_GPIOPinGeneric3";
CAPTURE1.peripheral.$assign                 = "TIMA0";
CAPTURE1.peripheral.ccp0Pin.$assign         = "boosterpack.4";
CAPTURE1.peripheral.ccp2Pin.$assign         = "boosterpack.30";
CAPTURE1.peripheral.ccp3Pin.$assign         = "boosterpack.2";

const Board = scripting.addModule("/ti/driverlib/Board", {}, false);

CAPTURE2.timerClkPrescale                   = 32;
CAPTURE2.captureInputMode                   = "multi";
CAPTURE2.multi_countMode                    = "DL_TIMER_COUNT_MODE_UP";
CAPTURE2.ccIndexMulti                       = [0,1];
CAPTURE2.multi_cvae                         = "DL_TIMER_COUNT_AFTER_EN_ZERO";
CAPTURE2.$name                              = "RC_TIM1";
CAPTURE2.timerPeriod                        = "65ms";
CAPTURE2.multi_ch1_captEdgeDetection        = "DL_TIMER_CC_CCOND_TRIG_FALL";
CAPTURE2.interrupts                         = ["CC0_UP","CC1_UP"];
CAPTURE2.crossTriggerAuthority              = "Secondary";
CAPTURE2.multi_countRep                     = "DL_TIMER_REPEAT_MODE_ENABLED";
CAPTURE2.multi_ch1_input_mode               = "DL_TIMER_CC_IN_SEL_CCPX_PAIR";
CAPTURE2.multi_ch_zero                      = 0;
CAPTURE2.timerStartTimer                    = true;
CAPTURE2.ccp0PinConfig.hideOutputInversion  = scripting.forceWrite(false);
CAPTURE2.ccp0PinConfig.onlyInternalResistor = scripting.forceWrite(false);
CAPTURE2.ccp0PinConfig.passedPeripheralType = scripting.forceWrite("Digital");
CAPTURE2.ccp0PinConfig.$name                = "ti_driverlib_gpio_GPIOPinGeneric2";
CAPTURE2.peripheral.$assign                 = "TIMG7";
CAPTURE2.peripheral.ccp0Pin.$assign         = "boosterpack.38";

GPIO1.$name                         = "RC_IN";
GPIO1.associatedPins.create(2);
GPIO1.associatedPins[0].direction   = "INPUT";
GPIO1.associatedPins[0].polarity    = "FALL";
GPIO1.associatedPins[0].interruptEn = true;
GPIO1.associatedPins[0].$name       = "CH5";
GPIO1.associatedPins[0].pin.$assign = "boosterpack.35";
GPIO1.associatedPins[1].$name       = "CH6";
GPIO1.associatedPins[1].direction   = "INPUT";
GPIO1.associatedPins[1].polarity    = "FALL";
GPIO1.associatedPins[1].interruptEn = true;
GPIO1.associatedPins[1].pin.$assign = "boosterpack.36";

PWM1.clockPrescale                      = 32;
PWM1.timerCount                         = 20000;
PWM1.timerStartTimer                    = true;
PWM1.pwmMode                            = "EDGE_ALIGN_UP";
PWM1.enableShadowLoad                   = true;
PWM1.$name                              = "MOTOR_PWM";
PWM1.peripheral.$assign                 = "TIMA1";
PWM1.peripheral.ccp0Pin.$assign         = "boosterpack.9";
PWM1.peripheral.ccp1Pin.$assign         = "boosterpack.10";
PWM1.PWM_CHANNEL_0.$name                = "ti_driverlib_pwm_PWMTimerCC0";
PWM1.PWM_CHANNEL_0.initVal              = "HIGH";
PWM1.PWM_CHANNEL_0.dutyCycle            = 50;
PWM1.PWM_CHANNEL_0.shadowUpdateMode     = "ZERO_EVT";
PWM1.PWM_CHANNEL_0.ccValue              = 1500;
PWM1.PWM_CHANNEL_1.$name                = "ti_driverlib_pwm_PWMTimerCC1";
PWM1.PWM_CHANNEL_1.initVal              = "HIGH";
PWM1.PWM_CHANNEL_1.dutyCycle            = 50;
PWM1.PWM_CHANNEL_1.shadowUpdateMode     = "ZERO_EVT";
PWM1.PWM_CHANNEL_1.ccValue              = 1500;
PWM1.ccp0PinConfig.direction            = scripting.forceWrite("OUTPUT");
PWM1.ccp0PinConfig.hideOutputInversion  = scripting.forceWrite(false);
PWM1.ccp0PinConfig.onlyInternalResistor = scripting.forceWrite(false);
PWM1.ccp0PinConfig.passedPeripheralType = scripting.forceWrite("Digital");
PWM1.ccp0PinConfig.$name                = "ti_driverlib_gpio_GPIOPinGeneric4";
PWM1.ccp1PinConfig.direction            = scripting.forceWrite("OUTPUT");
PWM1.ccp1PinConfig.hideOutputInversion  = scripting.forceWrite(false);
PWM1.ccp1PinConfig.onlyInternalResistor = scripting.forceWrite(false);
PWM1.ccp1PinConfig.passedPeripheralType = scripting.forceWrite("Digital");
PWM1.ccp1PinConfig.$name                = "ti_driverlib_gpio_GPIOPinGeneric5";

SYSCTL.MFCLKEn = true;

/**
 * Pinmux solution for unlocked pins/peripherals. This ensures that minor changes to the automatic solver in a future
 * version of the tool will not impact the pinmux you originally saw.  These lines can be completely deleted in order to
 * re-solve from scratch.
 */
Board.peripheral.$suggestSolution          = "DEBUGSS";
Board.peripheral.swclkPin.$suggestSolution = "j25_expansion.16";
Board.peripheral.swdioPin.$suggestSolution = "j25_expansion.14";
SYSCTL.peripheral.$suggestSolution         = "SYSCTL";
